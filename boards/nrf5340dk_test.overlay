/* boards/nrf5340dk_test.overlay */

/ {
    /* Add emulated GPIO controller - ONLY for the button */
    emul_gpio: gpio_emul {
        compatible = "zephyr,gpio-emul";
        status = "okay";
        gpio-controller;
        #gpio-cells = <2>;
        ngpios = <4>;
    };
};

/* Override ONLY the button0 node to use emulated GPIO */
&button0 {
    gpios = <&emul_gpio 0 (GPIO_PULL_UP | GPIO_ACTIVE_LOW)>;
    label = "Emulated Button";
};